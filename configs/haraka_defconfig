## configs/haraka_defconfig
```kconfig
BR2_x86_64=y
BR2_CCACHE=y
BR2_KERNEL_HEADERS_4_14=y
BR2_TOOLCHAIN_BUILDROOT_WCHAR=y
BR2_TOOLCHAIN_BUILDROOT_CXX=y
BR2_PACKAGE_NODEJS=y
BR2_PACKAGE_NODEJS_MODULES_ADDITIONAL="Haraka"
```

## configs/mariadb_defconfig
```kconfig
BR2_x86_64=y
BR2_CCACHE=y
BR2_KERNEL_HEADERS_4_14=y
BR2_TOOLCHAIN_BUILDROOT_CXX=y
BR2_PACKAGE_MYSQL=y
BR2_PACKAGE_MARIADB=y
BR2_PACKAGE_MARIADB_SERVER=y
```

## configs/mongodb_defconfig
```kconfig
BR2_x86_64=y
BR2_CCACHE=y
BR2_TOOLCHAIN_BUILDROOT_GLIBC=y
BR2_KERNEL_HEADERS_4_14=y
BR2_TOOLCHAIN_BUILDROOT_CXX=y
BR2_PACKAGE_MONGODB=y
```

## configs/postgres_defconfig
```kconfig
BR2_x86_64=y
BR2_CCACHE=y
BR2_KERNEL_HEADERS_4_14=y
BR2_TOOLCHAIN_BUILDROOT_CXX=y
BR2_PACKAGE_OPENSSL=y
BR2_PACKAGE_POSTGRESQL=y
BR2_PACKAGE_LIBAIO=y
BR2_PACKAGE_LIBXML2=y
BR2_PACKAGE_READLINE=y
```

## configs/rabbitmq_defconfig
```kconfig
BR2_x86_64=y
BR2_CCACHE=y
BR2_KERNEL_HEADERS_4_14=y
BR2_PACKAGE_ERLANG=y
BR2_PACKAGE_RABBITMQ_SERVER=y
```
